## Kconfig
```kconfig
choice PROSPECTOR_STATUS_SCREEN_LAYOUT
    prompt "Status screen layout"
    default PROSPECTOR_STATUS_SCREEN_CLASSIC

config PROSPECTOR_STATUS_SCREEN_CLASSIC
    bool "Classic layout"
    help
        Standard Prospector status screen

config PROSPECTOR_STATUS_SCREEN_GLOVE80
    bool "Glove80 layout"
    help
        Modifier/caps status row, cross-fading layer name, two battery cells with the OS logo

config PROSPECTOR_STATUS_SCREEN_RADII
    bool "Radii layout"
    help
        Colorful grid layout with rounded widgets

config PROSPECTOR_STATUS_SCREEN_FIELD
    bool "Field layout"
    help
        Minimal layout with flowing typing activity visualization

config PROSPECTOR_STATUS_SCREEN_OPERATOR
    bool "Operator layout"
    help
        Technical and information dense layout

endchoice

config PROSPECTOR_ROTATE_DISPLAY_180
    bool "Rotate the display 180 degrees"
    default n

config PROSPECTOR_SHOW_MODIFIERS
    bool "Display modifier key indicators (Cmd, Opt, Ctrl, Shift)"
    default y

config PROSPECTOR_SHOW_INACTIVE_MODIFIERS
    bool "Show inactive modifier indicators (dim when not pressed)"
    default y
    depends on PROSPECTOR_SHOW_MODIFIERS
    help
      When enabled, inactive modifiers are shown with a dim color.
      When disabled, inactive modifiers are hidden completely.
      Only affects classic and field layouts.

config PROSPECTOR_MODIFIER_ORDER
    string "Modifier display order"
    default "GACS"
    depends on PROSPECTOR_SHOW_MODIFIERS
    help
      Order of modifier indicators. Use exactly 4 characters:
      G=GUI/Cmd, A=Alt/Opt, C=Control, S=Shift.
      Each character must appear exactly once.

choice PROSPECTOR_MODIFIER_OS
    prompt "Modifier key style"
    default PROSPECTOR_MODIFIER_OS_MAC
    depends on PROSPECTOR_SHOW_MODIFIERS

config PROSPECTOR_MODIFIER_OS_GENERIC
    bool "Generic (CTRL, ALT, GUI, SHFT)"

config PROSPECTOR_MODIFIER_OS_WINDOWS
    bool "Windows"

config PROSPECTOR_MODIFIER_OS_MAC
    bool "Mac"

endchoice

config PROSPECTOR_USE_AMBIENT_LIGHT_SENSOR
    bool "Use ambient light sensor for auto brightness"
    default y

config PROSPECTOR_FIXED_BRIGHTNESS
    int "Fixed display brightness"
    default 50
    range 1 100
    depends on !PROSPECTOR_USE_AMBIENT_LIGHT_SENSOR

config PROSPECTOR_LAYER_NAME_UPPERCASE
    bool "Display layer names in uppercase"
    default y
    help
      When enabled, layer names will be converted to uppercase for display.

if PROSPECTOR_STATUS_SCREEN_GLOVE80

config PROSPECTOR_BATTERY_CELLS
    int "Battery cells to show (first N split peripherals)"
    default 2
    help
      Only the first N peripheral slots get a battery cell, e.g. the two keyboard halves when
      trackpads are paired as further peripherals.

config PROSPECTOR_BATTERY_SWAP
    bool "Swap the battery cells (show slot 1 on the left)"
    help
      Split slot 0 is the half that was paired first. Enable this when that is the right half,
      so the left cell shows the left half.

config PROSPECTOR_LAYER_ROLLER_HIDE_UNNAMED
    bool "Hide layers without a display-name from the layer display"
    help
      Layers with no (or an empty) display-name are never shown; while one is active the
      display shows the highest active named layer beneath it. Useful for helper layers such
      as home-row-mod layers that would otherwise flash by while typing.

config PROSPECTOR_LAYER_FADE_MS
    int "Layer name cross-fade time in milliseconds (0 = instant)"
    default 150
    range 0 1000

config PROSPECTOR_LAYER_NAME_SKIP
    string "Comma-separated layer display-names never shown as the layer name"
    default "macOS"
    help
      Mode layers that are shown elsewhere (e.g. the macOS layer, shown as the OS icon) are
      skipped; the layer name shows the highest active layer beneath them.

config PROSPECTOR_OS_MACOS_LAYER
    string "Layer display-name that means macOS is selected"
    default "macOS"

choice PROSPECTOR_DEFAULT_OS
    prompt "OS icon shown when no OS layer is active"
    default PROSPECTOR_DEFAULT_OS_LINUX

config PROSPECTOR_DEFAULT_OS_LINUX
    bool "Linux"

config PROSPECTOR_DEFAULT_OS_MACOS
    bool "macOS"

config PROSPECTOR_DEFAULT_OS_WINDOWS
    bool "Windows"

endchoice

endif
```

## boards/shields/prospector_adapter/src/layouts/glove80/Kconfig.defconfig
```kconfig
if PROSPECTOR_STATUS_SCREEN_GLOVE80

config ZMK_DISPLAY_STATUS_SCREEN_CUSTOM
    select LV_USE_LABEL
    select LV_USE_BAR
    select LV_USE_FLEX
    select LV_USE_CHART
    select ZMK_WPM
    select LV_COLOR_SCREEN_TRANSP

endif
```
